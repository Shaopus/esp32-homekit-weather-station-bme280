## components/__config/Kconfig.projbuild
```kconfig
menu "IoT Solution settings"
    config IOT_SOLUTION_EMBED
        bool
        default y
    menu "IoT Components Management"
        menu "General functions"
            config IOT_DAC_AUDIO_ENABLE
                bool "DAC_AUDIO_ENABLE(Built-in DAC)"
                default y
                help
                    "Select this one to enable audio DAC component"
                   
            config IOT_IR_ENABLE
                bool "IR(remote controller) DEVICE ENABLE"
                default y
                help
                    "Select this to enable the IR remote controller component"
            config IOT_TOUCH_ENABLE
                bool "TOUCH_DEVICE_ENABLE(based on touch sensor)"
                default y
                help
                    "Select this one to enable touch device component"
                    
                menu "Touch Sensor"
                depends on IOT_TOUCH_ENABLE
                    config DATA_SCOPE_DEBUG
                        bool "Data scope debug (ESP-Tuning Tool)"
                        default n
                        help
                            Enable scope debug function. Print the touch sensor raw data to ESP-Tuning tool via UART.
                            ESP-Tuning tool is touch sensor tune tool. User can monitor the data of each touch channel,
                            evaluate the touch system's touch performance (sensitivity, SNR, stability, channel coupling)
                            and determine the threshold for each channel.
                            attention 1. Choose a UART port that will only be used for scope debug.
                            attention 2. Use this feature only during the testing phase.
                            attention 3. ESP-Tuning tool can be downloaded from Espressif's official website.

                        menu "Data scope port setting"
                        depends on DATA_SCOPE_DEBUG
                            config SCOPE_DEBUG_TASK_PRIORITY
                                int "Scope debug task priority"
                                range 0 25
                                default 5

                            choice SCOPE_PORT_NUM
                                bool "Uart number (debug port)"
                                default SCOPE_PORT_NUM_UART0
                                help 
                                    Choose a UART port that will only be used for scope debug. UART0 or UART1 or UART2.
                                config SCOPE_PORT_NUM_UART0
                                    bool "UART0"
                                config SCOPE_PORT_NUM_UART1
                                    bool "UART1"
                                config SCOPE_PORT_NUM_UART2
                                    bool "UART2"
                            endchoice
                                config SCOPE_DEBUG_PORT_NUM
                                    int
                                    default 0 if SCOPE_PORT_NUM_UART0
                                    default 1 if SCOPE_PORT_NUM_UART1
                                    default 2 if SCOPE_PORT_NUM_UART2
                            
                            choice SCOPE_PORT_BAUD_RATE
                                bool "Baud rate (debug port)"
                                default SCOPE_PORT_BAUD_RATE_921600
                                help
                                      Set the same parameters on the tool side.
                                config SCOPE_PORT_BAUD_RATE_115200
                                    bool "115200 (baud rate)"
                                config SCOPE_PORT_BAUD_RATE_256000
                                    bool "256000 (baud rate)"
                                config SCOPE_PORT_BAUD_RATE_460800
                                    bool "460800 (baud rate)"
                                config SCOPE_PORT_BAUD_RATE_921600
                                    bool "921600 (baud rate)[Default]"
                                config SCOPE_PORT_BAUD_RATE_1152000
                                    bool "1152000 (baud rate)"
                            endchoice
                            config SCOPE_DEBUG_BAUD_RATE
                                int 
                                default 115200  if SCOPE_PORT_BAUD_RATE_115200
                                default 256000  if SCOPE_PORT_BAUD_RATE_256000
                                default 460800  if SCOPE_PORT_BAUD_RATE_460800
                                default 921600  if SCOPE_PORT_BAUD_RATE_921600
                                default 1152000 if SCOPE_PORT_BAUD_RATE_1152000
                            
                            config SCOPE_DEBUG_UART_TXD_IO
                                int "Uart TXD IO number"
                                range 0 34
                                default 1
                                
                            config SCOPE_DEBUG_UART_RXD_IO
                                int "Uart RXD IO number"
                                range 0 39
                                default 3
                        endmenu
                endmenu
                
            config IOT_ULP_ENABLE
                bool "ULP_MONITOR_DEVICE_ENABLE"
                default n
                help
                    "Select this one to enable ULP monitor device"
            config IOT_LOWPOWER_APP_FRAMEWORK_ENABLE
                bool "LOWPOWER_APP_FRAMEWORK_ENABLE"
                default n
                help
                    "Select this one to enable lowpower application framework"
            config IOT_BUTTON_ENABLE
                bool "BUTTON_DEVICE_ENABLE"
                default y
                help
                    "Select this one to enable button device"
                    
                menu "Button"
                depends on IOT_BUTTON_ENABLE
                    choice TIMER_IMPLEMENT
                    bool "Button Timer Mode"
                        default BUTTON_USE_ESP_TIMER
                    help 
                        Choose a implementation of timer for button instance.
                    config BUTTON_USE_RTOS_TIMER
                        bool "Use FreeRTOS Timer"
                    config BUTTON_USE_ESP_TIMER
                        bool "Use ESP Timer"
                    endchoice
                    config IO_GLITCH_FILTER_TIME_MS
                        int "IO glitch filter timer ms (10~100)"
                        range 10 100
                        default 50
                endmenu
            config IOT_DEBUG_ENABLE
                bool "DEBUG_COMPONENT_ENABLE"
                default n
                help
                    "Select this one to enable common debug function"
            config IOT_LED_ENABLE
                bool "LED_DEVICE_ENABLE"
                default y
                help
                    "Select this one to enable LED device"
                menu "Status LED"
                    depends on IOT_LED_ENABLE
                    config STATUS_LED_QUICK_BLINK_FREQ
                        int "Quick blink frequency(Hz)"
                        range 1 20
                        default 5
                    config STATUS_LED_SLOW_BLINK_FREQ
                        int "Slow blink frequency(Hz)"
                        range 1 20
                        default 1
                    
                    choice STATUS_LED_SPEED_MODE_CHOICE
                        bool "LEDC speed mode"
                        default USE_LEDC_HIGHSPEED_MODE
                        config USE_LEDC_HIGHSPEED_MODE
                            bool "Select LEDC high-speed mode for status LED"
                        config USE_LEDC_LOWSPEED_MODE
                            bool "Select LEDC low-speed mode for status LED" 
                    endchoice
                    config STATUS_LED_SPEED_MODE
                        int
                        default 0 if USE_LEDC_HIGHSPEED_MODE
                        default 1 if USE_LEDC_LOWSPEED_MODE
                        
                    # -------------- led quick blink config ---------------
                        
                    choice STATUS_LED_QUICK_BLINK_CHANNEL_CHOICE
                        bool  "Status LED quick blink channel"
                        default STATUS_LED_QUICK_BLINK_CHANNEL_0
                        
                        config STATUS_LED_QUICK_BLINK_CHANNEL_0
                            bool "channel 0"
                        config STATUS_LED_QUICK_BLINK_CHANNEL_1
                            bool "channel 1"
                        config STATUS_LED_QUICK_BLINK_CHANNEL_2
                            bool "channel 2"                
                        config STATUS_LED_QUICK_BLINK_CHANNEL_3
                            bool "channel 3"                
                        config STATUS_LED_QUICK_BLINK_CHANNEL_4
                            bool "channel 4"                
                        config STATUS_LED_QUICK_BLINK_CHANNEL_5
                            bool "channel 5"
                        config STATUS_LED_QUICK_BLINK_CHANNEL_6
                            bool "channel 6"                
                        config STATUS_LED_QUICK_BLINK_CHANNEL_7
                            bool "channel 7" 
                        config STATUS_LED_QUICK_BLINK_CHANNEL_DEF
                            bool "channel default(0)"
                    endchoice
                    config STATUS_LED_QUICK_BLINK_CHANNEL
                        int 
                        default 0 if STATUS_LED_QUICK_BLINK_CHANNEL_0
                        default 1 if STATUS_LED_QUICK_BLINK_CHANNEL_1
                        default 2 if STATUS_LED_QUICK_BLINK_CHANNEL_2
                        default 3 if STATUS_LED_QUICK_BLINK_CHANNEL_3
                        default 4 if STATUS_LED_QUICK_BLINK_CHANNEL_4
                        default 5 if STATUS_LED_QUICK_BLINK_CHANNEL_5
                        default 6 if STATUS_LED_QUICK_BLINK_CHANNEL_6
                        default 7 if STATUS_LED_QUICK_BLINK_CHANNEL_7
                        default 0 if STATUS_LED_QUICK_BLINK_CHANNEL_DEF
                    
                    choice STATUS_LED_QUICK_BLINK_TIMER_CHOICE
                        bool  "Status LED quick blink timer"
                        default STATUS_LED_QUICK_BLINK_TIMER_0
                        
                        config STATUS_LED_QUICK_BLINK_TIMER_0
                            bool "TIMER 0"
                        config STATUS_LED_QUICK_BLINK_TIMER_1
                            bool "TIMER 1"
                        config STATUS_LED_QUICK_BLINK_TIMER_2
                            bool "TIMER 2"                
                        config STATUS_LED_QUICK_BLINK_TIMER_3
                            bool "TIMER 3"       
                        config STATUS_LED_QUICK_BLINK_TIMER_DEF
                            bool "TIMER default(0)"
                    endchoice
                    config STATUS_LED_QUICK_BLINK_TIMER
                        int 
                        default 0 if STATUS_LED_QUICK_BLINK_TIMER_0
                        default 1 if STATUS_LED_QUICK_BLINK_TIMER_1
                        default 2 if STATUS_LED_QUICK_BLINK_TIMER_2
                        default 3 if STATUS_LED_QUICK_BLINK_TIMER_3
                        default 0 if STATUS_LED_QUICK_BLINK_TIMER_DEF
                    
                    
                        
                    # --------------- led slow blink config ----------------
                    
                    choice STATUS_LED_SLOW_BLINK_CHANNEL_CHOICE
                        bool  "Status LED slow blink channel"
                        default STATUS_LED_SLOW_BLINK_CHANNEL_1
                        
                        config STATUS_LED_SLOW_BLINK_CHANNEL_0
                            bool "channel 0"
                        config STATUS_LED_SLOW_BLINK_CHANNEL_1
                            bool "channel 1"
                        config STATUS_LED_SLOW_BLINK_CHANNEL_2
                            bool "channel 2"                
                        config STATUS_LED_SLOW_BLINK_CHANNEL_3
                            bool "channel 3"                
                        config STATUS_LED_SLOW_BLINK_CHANNEL_4
                            bool "channel 4"                
                        config STATUS_LED_SLOW_BLINK_CHANNEL_5
                            bool "channel 5"
                        config STATUS_LED_SLOW_BLINK_CHANNEL_6
                            bool "channel 6"                
                        config STATUS_LED_SLOW_BLINK_CHANNEL_7
                            bool "channel 7"  
                        config STATUS_LED_SLOW_BLINK_CHANNEL_DEF
                            bool "channel default(1)"
                    endchoice
                    config STATUS_LED_SLOW_BLINK_CHANNEL
                        int 
                        default 0 if STATUS_LED_SLOW_BLINK_CHANNEL_0
                        default 1 if STATUS_LED_SLOW_BLINK_CHANNEL_1
                        default 2 if STATUS_LED_SLOW_BLINK_CHANNEL_2
                        default 3 if STATUS_LED_SLOW_BLINK_CHANNEL_3
                        default 4 if STATUS_LED_SLOW_BLINK_CHANNEL_4
                        default 5 if STATUS_LED_SLOW_BLINK_CHANNEL_5
                        default 6 if STATUS_LED_SLOW_BLINK_CHANNEL_6
                        default 7 if STATUS_LED_SLOW_BLINK_CHANNEL_7   
                        default 1 if STATUS_LED_SLOW_BLINK_CHANNEL_DEF
                         
                    choice STATUS_LED_SLOW_BLINK_TIMER_CHOICE
                        bool  "Status LED slow blink timer"
                        default STATUS_LED_SLOW_BLINK_TIMER_1
                        
                        config STATUS_LED_SLOW_BLINK_TIMER_0
                            bool "TIMER 0"
                        config STATUS_LED_SLOW_BLINK_TIMER_1
                            bool "TIMER 1"
                        config STATUS_LED_SLOW_BLINK_TIMER_2
                            bool "TIMER 2"                
                        config STATUS_LED_SLOW_BLINK_TIMER_3
                            bool "TIMER 3"     
                        config STATUS_LED_SLOW_BLINK_TIMER_DEF
                            bool "TIMER default(1)"
                    endchoice
                    config STATUS_LED_SLOW_BLINK_TIMER
                        int 
                        default 0 if STATUS_LED_SLOW_BLINK_TIMER_0
                        default 1 if STATUS_LED_SLOW_BLINK_TIMER_1
                        default 2 if STATUS_LED_SLOW_BLINK_TIMER_2
                        default 3 if STATUS_LED_SLOW_BLINK_TIMER_3   
                        default 1 if STATUS_LED_SLOW_BLINK_TIMER_DEF   
                        
                                 
                    # ---------------- led night mode config ------------------
                    
                    config STATUS_LED_NIGHT_MODE_ENABLE
                        bool "Status LED night mode enable"
                        default y
                        
                        choice STATUS_LED_NIGHT_MODE_CHANNEL_CHOICE
                            bool  "Status LED night mode channel"
                            default STATUS_LED_NIGHT_MODE_CHANNEL_2
                            depends on STATUS_LED_NIGHT_MODE_ENABLE
                            
                            config STATUS_LED_NIGHT_MODE_CHANNEL_0
                                bool "channel 0"
                            config STATUS_LED_NIGHT_MODE_CHANNEL_1
                                bool "channel 1"
                            config STATUS_LED_NIGHT_MODE_CHANNEL_2
                                bool "channel 2"                
                            config STATUS_LED_NIGHT_MODE_CHANNEL_3
                                bool "channel 3"                
                            config STATUS_LED_NIGHT_MODE_CHANNEL_4
                                bool "channel 4"                
                            config STATUS_LED_NIGHT_MODE_CHANNEL_5
                                bool "channel 5"
                            config STATUS_LED_NIGHT_MODE_CHANNEL_6
                                bool "channel 6"                
                            config STATUS_LED_NIGHT_MODE_CHANNEL_7
                                bool "channel 7"      
                            config STATUS_LED_NIGHT_MODE_CHANNEL_DEF
                                bool "channel default(2)"
                        endchoice
                        config STATUS_LED_NIGHT_MODE_CHANNEL
                            int 
                            default 0 if STATUS_LED_NIGHT_MODE_CHANNEL_0
                            default 1 if STATUS_LED_NIGHT_MODE_CHANNEL_1
                            default 2 if STATUS_LED_NIGHT_MODE_CHANNEL_2
                            default 3 if STATUS_LED_NIGHT_MODE_CHANNEL_3
                            default 4 if STATUS_LED_NIGHT_MODE_CHANNEL_4
                            default 5 if STATUS_LED_NIGHT_MODE_CHANNEL_5
                            default 6 if STATUS_LED_NIGHT_MODE_CHANNEL_6
                            default 7 if STATUS_LED_NIGHT_MODE_CHANNEL_7  
                            default 2 if STATUS_LED_NIGHT_MODE_CHANNEL_DEF
                        
                        choice STATUS_LED_NIGHT_MODE_TIMER_CHOICE
                            bool  "Status LED night mode timer"
                            default STATUS_LED_NIGHT_MODE_TIMER_2
                            depends on STATUS_LED_NIGHT_MODE_ENABLE
                            
                            config STATUS_LED_NIGHT_MODE_TIMER_0
                                bool "TIMER 0"
                            config STATUS_LED_NIGHT_MODE_TIMER_1
                                bool "TIMER 1"
                            config STATUS_LED_NIGHT_MODE_TIMER_2
                                bool "TIMER 2"                
                            config STATUS_LED_NIGHT_MODE_TIMER_3
                                bool "TIMER 3"    
                            config STATUS_LED_NIGHT_MODE_TIMER_DEF
                                bool "TIMER default(2)"
                        endchoice
                        config STATUS_LED_NIGHT_MODE_TIMER
                            int 
                            default 0 if STATUS_LED_NIGHT_MODE_TIMER_0
                            default 1 if STATUS_LED_NIGHT_MODE_TIMER_1
                            default 2 if STATUS_LED_NIGHT_MODE_TIMER_2
                            default 3 if STATUS_LED_NIGHT_MODE_TIMER_3  
                            default 2 if STATUS_LED_NIGHT_MODE_TIMER_DEF  
                endmenu  
                
                
            config IOT_LIGHT_ENABLE
                bool "LIGHT_DEVICE_ENABLE"
                default y
                help
                    "Select this one to enable LIGHT device"
            config IOT_OTA_FUNC_ENABLE
                bool "OTA_FUNC_ENABLE"
                default n
                help
                    "Select this one to enable OTA FUNC"   
            config IOT_PARAM_ENABLE
                bool "PARAM_FUNC_ENABLE"
                default n
                help
                    "Select this one to enable PARAM FUNC"   
            config IOT_POWER_METER_ENABLE
                bool "POWER_METER_ENABLE"
                default n
                help
                    "Select this one to enable power meter component"   
                    
                menu "Power meter"
                    depends on IOT_POWER_METER_ENABLE        
            
                    choice POWER_METER_PCNT_CHANNEL_CHOICE
                        bool "power meter pcnt channel"
                        default USE_PCNT_CHANNEL_0
                        config USE_PCNT_CHANNEL_0
                            bool "Select PCNT_CHANNEL_0 for power meter"
                        config USE_PCNT_CHANNEL_1
                            bool "Select PCNT_CHANNEL_1 for power meter"
                    endchoice
                    config POWER_METER_PCNT_CHANNEL
                        int
                        default 0 if USE_PCNT_CHANNEL_0
                        default 1 if USE_PCNT_CHANNEL_1
                    choice POWER_METER_VALUE_MULTIPLE_CHOICE
                        bool "To choose different value accuracy"
                        default VALUW_MULTIPLE_100
                        config VALUE_MULTIPLE_1
                            bool "read_value = (int)real_value"
                        config VALUE_MULTIPLE_10
                            bool "read_value = (int)(real_value * 10)"
                        config VALUE_MULTIPLE_100
                            bool "read_value = (int)(real_value * 100)"
                    endchoice
                    config POWER_METER_VALUE_MULTIPLE
                        int
                        default 1 if VALUE_MULTIPLE_1
                        default 10 if VALUE_MULTIPLE_10
                        default 100 if VALUE_MULTIPLE_100
                    config POWER_METER_PCNT_FILTER
                        int "Filter of pcnt channel, counter in APB_CLK cycles (1~1023)"
                        range 1 1023
                        default 100
            
                    config POWER_METER_ZERO_PERIOD_MS
                        int "Time(ms) to decide whether measure value is 0 (1000 ~ 10000)"
                        range 1000 10000
                        default 5000
                endmenu
            config IOT_RELAY_ENABLE
                bool "RELAY ENABLE"
                default n
                help
                    "Select this one to enable relay component"  
                menu "Relay"
                    depends on IOT_RELAY_ENABLE
                    config DFLIPFLOP_CLK_PERIOD_US
                        int "Dflipflop clock period us (2~1000)"
                        range 2 1000
                        default 500
                endmenu
                
                                  
            config IOT_WEEKLY_TIMER_ENABLE
                bool "WEEKLY TIMER ENABLE"
                default n
                help
                    "Select this one to enable weekly timer component"

            config IOT_ADC_ENABLE
                bool "ADC_DEVICE_ENABLE"
                default y
                help
                    "Select this one to enable ADC device"
        endmenu     
        
        menu "I2C devices"
            config IOT_APDS9960_ENABLE
                bool "APDS9960 ENABLE"
                default y
                help
                    "Select this one to enable APDS9960 device"   
            config IOT_AT24C02_ENABLE
                bool "AT24C02 ENABLE"
                default y
                help
                    "Select this one to enable AT24C02 device"
            config IOT_BME280_ENABLE
                bool "BME280 ENABLE"
                default y
                help
                    "Select this one to enable BME280 device"
            config IOT_CH450_ENABLE
                bool "CH450 ENABLE"
                default y
                help
                    "Select this one to enable CH450 device" 
            config IOT_HT16C21_ENABLE
                bool "HT16C21 ENABLE"
                default y
                help
                    "Select this one to enable HT16C21 device"
            config IOT_IS31FL3XXX_ENABLE
                bool "IS31FL3XXX ENABLE"
                default y
                help
                    "Select this one to enable IS31FL3XXX device"
            config IOT_MCP23017_ENABLE
                bool "MCP23017 ENABLE"
                default y
                help
                    "Select this one to enable MCP23017 device"
            config IOT_OLED_ENABLE
                bool "OLED_DEV_ENABLE(SSD1306)"
                default y
                help
                    "Select this one to enable OLED device component"
                menu "OLED device"
                    depends on OLED_ENABLE 
                endmenu     
                
            #------------------
            #--  I2C sensor --- 
            #------------------            
            config IOT_BH1750_ENABLE
                bool "SENSOR_BH1750_ENABLE"
                default y
                help
                    "Select this one to enable BH1750 device component"  
            config IOT_HTS221_ENABLE
                bool "SENSOR_HTS221_ENABLE"
                default y
                help
                    "Select this one to enable HTS221 device component"
            config IOT_LIS2DH12_ENABLE
                bool "SENSOR_LIS2DH12_ENABLE"
                default y
                help
                    "Select this one to enable LIS2DH12 device component"
            config IOT_MVH3004D_ENABLE
                bool "SENSOR_MVH3004D_ENABLE"
                default y
                help
                    "Select this one to enable MVH3004D device component"
            config IOT_VEML6040_ENABLE
                bool "SENSOR_VEML6040_ENABLE"
                default y
                help
                    "Select this one to enable VEML6040 device component"
            config IOT_HDC2010_ENABLE
                bool "SENSOR_HDC2010_ENABLE"
                default y
                help
                    "Select this one to enable HDC2010 device component"                    
            config IOT_FT5X06_ENABLE
                bool "SENSOR_FT5X06_ENABLE"
                default y
                help
                    "Select this one to enable FT5X06 device component"

            config IOT_MPU6050_ENABLE
                bool "SENSOR_MPU6050_ENABLE"
                default y
                help
                    "Select this one to enable MPU6050 device component"
        endmenu

    endmenu
    
endmenu
```
